## config/Kconfig
```kconfig
# fantuan-kernel configuration schema (Kconfig-lite, C1).
#
# Read by tools/kconfig.py; consumed by every Rust crate's build.rs through
# the generated `cargo:rustc-cfg=kconfig_<lower>` lines. Syntax:
#
#   config NAME
#       bool "prompt"
#       default y|n
#       depends on NAME
#       help
#           free-form text
#
# App catalog fragments (C2): tools/appctl generates config/apps/<name>.kconfig
# with symbols named APP_<NAME>; kconfig.py merges every config/apps/*.kconfig
# fragment automatically when the directory exists. App symbols keep the
# CONFIG_APP_* prefix and never enter the kernel/base layer.

config SHELL
    bool "Built-in kernel shell (kernel-core)"
    default y
    help
        The built-in shell; the only always-on user interface (the Live
        kernel's boot set: kernel + boot + shell). Disabling it leaves the
        boot banner only (debug builds).

config BASH
    bool "GNU bash 5.3 as the default /bin/sh (GPLv3 separate program)"
    default y
    help
        Build and embed GNU bash 5.3 as /bin/sh: tools/build.sh resolves the
        pinned sources (tools/fetch-bash-src.sh), builds bash against
        libc-fantuan and embeds the stripped program. The sources are
        deliberately not tracked on main (THIRD_PARTY.md) and bash is never
        linked into the kernel. Off: dash stays /bin/dash and the built-in
        shell keeps the rescue builtins. This is the kernel-build gate; the
        generated CONFIG_APP_BASH is a separate app-catalog marker.

config TOOLS
    bool "Userland tool set"
    default n
    depends on SHELL
    help
        Interim bridge: the kernel-integrated ping/nslookup/wget shell
        commands (kernel-net, R7). Non-default; the app catalog's
        apps/{ping,nslookup,wget} take over at M14-4 and the in-kernel
        commands are retired then. Tools are add-ons and are never linked
        into the kernel or base.

config NET
    bool "NetBSD rump network stack (M11)"
    default n
    help
        The imported rump/NetBSD network stack (kernel-net). Off means the
        kernel boots without any networking code paths.

config NET_DRIVERS
    bool "Network drivers (e1000 / virtio-net)"
    default n
    depends on NET
    help
        The physical network adapters behind the net_ops registry.

config TLS
    bool "TLS / HTTPS (mbedTLS, M11 R8)"
    default n
    depends on NET
    help
        The TLS stack used by HTTPS tools; requires NET.

config VIRT
    bool "Hypervisor V2 (M14-7)"
    default n
    help
        The in-kernel hypervisor (VMX first, then SVM); off in every
        profile except hypervisor/all.

config GRAPHICS
    bool "fb_info / KMS API (M13) + GPU/PCI report (M12-6)"
    default n
    help
        The framebuffer/KMS graphics contract and its kernel demos, plus
        the read-only GPU/PCI report (display IDs/BARs/mapped aperture,
        PCIe link capability, ACPI thermal-zone hook) printed at boot and
        by the rescue shell `gpu` command. The `rescue` and `desktop`
        profiles select it; the minimal kernel links none of it.

config DESKTOP
    bool "Desktop session (M15)"
    default n
    depends on GRAPHICS
    help
        The XFCE/CDE desktop layer; requires GRAPHICS.

config RESCUE_REPAIR
    bool "Rescue/diagnostic commands + boot repair"
    default n
    help
        The rescue/diagnostic shell commands (diskhealth, lsos/lsmnt/mount,
        cat, hwdiag, lsdev, crypto-selftest), the bootrepair diagnosis and
        the grub-fix repair chain. Off in the default minimal kernel; the
        `rescue` profile enables it.

config IMAGER
    bool "Disk imager (clone)"
    default n
    help
        The verified raw block-device imager and its `clone` shell command
        (M12-2): a sector copy with a mandatory SHA-256 round-trip check,
        behind the repair YES gate and a hard source/destination size check.
        Off in the default minimal kernel; the rescue/net/tls/desktop
        profiles enable it.

config NTFS
    bool "NTFS read-only (M12-4/M12-5)"
    default n
    help
        The read-only NTFS reader: boot sector/$MFT validation, FILE
        records with fixups, attributes and runlists, $I30 directory
        enumeration, $DATA reads and the /mnt/win0 mount. It never writes
        to a Windows volume (there is no write entry point) and rejects
        compression/encryption/attribute-list structures with a clear
        error. Off in the default minimal kernel; the rescue/net/tls/
        desktop/hypervisor profiles enable it.

config SMBIOS
    bool "SMBIOS parsing (identity/DIMM/slots)"
    default n
    help
        The SMBIOS entry-point scan and structure parsers feeding the CPU/GPU
        identity, DIMM and slot diagnostics; off in the minimal shell.

config DEBUG_SELFTEST
    bool "rump/scheduler self-tests"
    default n
    depends on NET
    help
        The in-kernel self-test tasks that print the `rump:` markers used
        by tools/smoke-net.sh; off in release-shrunk builds.

config SECURE_WIPE
    bool "Shutdown RAM wipe (Live profile)"
    default n
    help
        Overwrite kernel memory, page caches, framebuffer and free RAM on
        clean shutdown/reboot (cold-boot mitigation; crashes cannot wipe).
        Enable in Live images; off elsewhere.
```
